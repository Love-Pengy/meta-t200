## conf/layer.conf
```bitbake
# We have a conf and classes directory, add to BBPATH
BBPATH .= ":${LAYERDIR}"

# We have a packages directory, add to BBFILES
BBFILES += "${LAYERDIR}/recipes-*/*/*.bb \
            ${LAYERDIR}/recipes-*/*/*.bbappend"

BBFILE_COLLECTIONS += "t200-core-image"
BBFILE_PATTERN_t200-core-image := "^${LAYERDIR}/"
BBFILE_PRIORITY_t200-core-image = "9"

# FIXME: change to walnascar
BBFILE_LAYERSERIES_COMPAT_t200-core-image = "scarthgap"
```
